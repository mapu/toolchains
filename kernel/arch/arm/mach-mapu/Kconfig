## kernel/arch/arm/mach-mapu/Kconfig
```kconfig
menu "MaPU SoC type"
	depends on ARCH_MAPU

config MACH_MAPU_A8
	bool "Support MaPU SoC for Cortex(tm)-A8"
	select CPU_V7
	select ARM_GIC
	select DW_APB_TIMER
	select ARM_AMBA
	help
	  Include support for the MaPU SoC platform.
	  This platform has a Cortex-A8 and 4 APE cores.
	  
choice
	prompt "Platform type"
	default MAPU_SIM

config MAPU_SIM
  depends on MACH_MAPU_A8
	bool "Gem5 Simulator"
	help
	  Support for ARM Gem5 simulator.

config MAPU_CHIP
  depends on MACH_MAPU_A8
	bool "Physical chip"
#	select NET_VENDOR_STMICRO
	help
	  Support for the real MaPU chips.
endchoice

endmenu
```

## kernel/drivers/apc/Kconfig
```kconfig
menu "MaPU Algebra Processing Cluster"

config APC
  depends on ARCH_MAPU
  default y
  bool "Enable MaPU Algebra Processing Cluster"
  ---help---
    This enables support for MaPU Algebra Processing Cluster.
    
endmenu
```

## u-boot/board/casia/mapu/Kconfig
```kconfig
if TARGET_MAPU

config SYS_ARCH
  default "arm"

config SYS_BOARD
	default "mapu"

config SYS_VENDOR
	default "casia"

choice 
  prompt "MaPU SOC Type"
  config  MAPU_SIM
    bool  "mapu_sim"
    help  
      This target is used for MaPU Simulator
  config  MAPU_CHIP
    bool  "mapu_chip"
    help
      This target is used for MaPU Physical chip
endchoice

if MAPU_SIM
config SYS_CONFIG_NAME
  default "mapu_sim"
endif

if MAPU_CHIP
config SYS_CONFIG_NAME
  default "mapu_chip"  
endif

endif
```
